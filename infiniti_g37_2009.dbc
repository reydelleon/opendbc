VERSION ""

NS_ :

BS_:

BU_: XXX

BO_ 421 NEW_MSG_1: 8 XXX
 SG_ NEW_SIGNAL_1 : 0|16@1+ (1,0) [0|255] "" XXX

BO_ 1762 NEW_MSG_2: 8 XXX
 SG_ NEW_SIGNAL_1 : 7|24@0+ (1,0) [0|255] "" XXX

BO_ 2 NEW_MSG_3: 8 XXX
 SG_ NEW_SIGNAL_1 : 7|16@0+ (1,0) [0|65535] "" XXX
 SG_ NEW_SIGNAL_2 : 23|16@0+ (1,0) [0|65535] "" XXX
 SG_ RPM : 7|24@0+ (1,0) [0|65535] "" XXX
 SG_ E : NaN|NaN@0+ (NaN,7) [NaN|2] "4" ,

BO_ 384 Engine RPM: 8 XXX
 SG_ RPM : 7|24@0+ (1,0) [0|16777215] "" XXX
